## drivers/net/wireless/uwe5622/Kconfig
```kconfig
config SPARD_WLAN_SUPPORT
	bool "Unisoc wireless Support"
	select AW_WIFI_DEVICE_UWE5622 if ARCH_SUNXI || ARCH_MESON
	
	select RK_WIFI_DEVICE_UWE5622 if ARCH_ROCKCHIP
	help
	  This is support for spreadtrum wireless chip.

if SPARD_WLAN_SUPPORT
source "drivers/net/wireless/uwe5622/unisocwcn/Kconfig"
source "drivers/net/wireless/uwe5622/unisocwifi/Kconfig"
source "drivers/net/wireless/uwe5622/tty-sdio/Kconfig"
endif
```

## drivers/usb/crgdrdphy/Kconfig
```kconfig
menuconfig AMLOGIC_CRG_DRDPHY
	tristate "Amlogic CRG DRD USB PHY support"
	depends on ARCH_MESON || COMPILE_TEST
	default y if ARCH_MESON
```
